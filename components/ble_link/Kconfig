## components/ble_link/Kconfig
```kconfig
menu "BLE link"

    config BLE_LINK_NAME_PREFIX
        string "Advertising name prefix"
        default "IR-RMT"
        help
            The last two bytes of the Bluetooth MAC are appended, giving a name
            like "IR-RMT-1A2B" so several boards can be told apart. The name is
            advertised in the scan response, because a 128-bit service UUID
            already consumes most of the advertising payload.

    config BLE_LINK_RX_MAX
        int "Maximum inbound message size (bytes)"
        range 256 4096
        default 2048
        help
            Upper bound for a reassembled request. Larger requests are rejected.
            Two pool buffers plus one reassembly buffer of this size are reserved
            in static RAM.

    config BLE_LINK_TASK_PRIORITY
        int "Link task priority"
        range 1 20
        default 9

    config BLE_LINK_TASK_STACK
        int "Link task stack size (bytes)"
        range 2048 8192
        default 4096
        help
            The RX handler runs on this task, so the stack must cover JSON
            parsing and storage calls.

endmenu
```

## components/board/Kconfig
```kconfig
menu "Board - ESP32-C3 SuperMini pin map"

    config BOARD_IR_RX_GPIO
        int "IR receiver output GPIO"
        range 0 21
        default 4
        help
            GPIO connected to the output of the demodulating IR receiver
            (TSOP1838 / VS1838B class). The receiver idles high.

    config BOARD_IR_TX_GPIO
        int "IR emitter drive GPIO"
        range 0 21
        default 5
        help
            GPIO driving the base/gate of the IR LED transistor or MOSFET.
            Never connect the IR LED directly to this pin.

    config BOARD_HOTKEY_GPIO
        int "Hotkey button GPIO"
        range 0 21
        default 0
        help
            Active-low momentary button to GND with the internal pull-up enabled.

    config BOARD_STATUS_LED_GPIO
        int "Status LED GPIO"
        range 0 21
        default 8
        help
            Onboard LED. GPIO8 is a strapping pin and is wired that way on the
            SuperMini, so it must not be repurposed.

    config BOARD_STATUS_LED_ACTIVE_LOW
        bool "Status LED is active-low"
        default y
        help
            The SuperMini onboard LED illuminates when its GPIO is driven low.

endmenu
```

## components/ir_capture/Kconfig
```kconfig
menu "IR capture (RMT RX)"

    config IR_CAPTURE_GLITCH_FILTER_NS
        int "Glitch filter (ns)"
        range 0 10000
        default 1000
        help
            Pulses shorter than this are discarded as noise. The shortest pulse in
            common IR protocols is around 300 us, so 1 us is a safe filter.

    config IR_CAPTURE_FRAME_GAP_MS
        int "End-of-frame idle gap (ms)"
        range 5 32
        default 25
        help
            Reception stops when one level persists longer than this, which marks
            the end of the frame. At the 1 MHz channel resolution the hardware
            ceiling is 32.767 ms, so larger values are rejected by the driver.

    config IR_CAPTURE_LEARN_WINDOW_MS
        int "Default learn inactivity window (ms)"
        range 1000 60000
        default 15000
        help
            Default value used by the bring-up flow. Every captured frame restarts
            the window, so several buttons can be learned in one session.

    config IR_CAPTURE_DEDUP_WINDOW_MS
        int "Repeat de-duplication window (ms)"
        range 50 2000
        default 400
        help
            A frame arriving within this time of the previous one is reported as a
            repeat instead of a new frame. Helps both full-frame repeats and short
            repeat codes (for example NEC).

    config IR_CAPTURE_MATCH_TOLERANCE_PERCENT
        int "Frame match relative tolerance (percent)"
        range 0 50
        default 15
        help
            Allowed deviation of a duration relative to the shorter of the two
            durations being compared.

    config IR_CAPTURE_MATCH_TOLERANCE_US
        int "Frame match absolute tolerance (us)"
        range 0 500
        default 100
        help
            Absolute deviation always accepted in addition to the relative
            tolerance, so that very short durations still compare reliably.

    config IR_CAPTURE_TASK_PRIORITY
        int "Capture task priority"
        range 1 20
        default 10

    config IR_CAPTURE_TASK_STACK_SIZE
        int "Capture task stack size (bytes)"
        range 2048 8192
        default 3072
        help
            The heavy buffers live in static storage, so the stack only needs to
            cover the call chain. 3 KB leaves comfortable headroom.

endmenu
```

## components/ir_playback/Kconfig
```kconfig
menu "IR playback (RMT TX)"

    config IR_PLAYBACK_TX_MEM_SYMBOLS
        int "RMT TX memory block size (symbols)"
        range 48 96
        default 48
        help
            Hardware FIFO owned by the TX channel. Must be even and at least
            SOC_RMT_MEM_WORDS_PER_CHANNEL (48 on the ESP32-C3). The copy encoder
            refills it in chunks, so it does not need to hold a whole frame.

    config IR_PLAYBACK_TX_TIMEOUT_MS
        int "Transmission completion timeout (ms)"
        range 100 20000
        default 3000
        help
            Upper bound for one rmt_tx_wait_all_done() call. A single frame is
            never longer than about 300 ms, so 3 s only trips on a real fault.

endmenu
```

## components/ir_store/Kconfig
```kconfig
menu "IR store (profiles and commands)"

    config IR_STORE_PARTITION_LABEL
        string "SPIFFS partition label"
        default "storage"
        help
            Must match the data/spiffs partition in partitions.csv.

    config IR_STORE_MOUNT_POINT
        string "SPIFFS mount point"
        default "/spiffs"
        help
            Keep this short: it must fit in the 48-byte command path buffers, so
            anything beyond 32 characters is truncated.

    config IR_STORE_MAX_PROFILES
        int "Maximum number of profiles"
        range 1 64
        default 16

    config IR_STORE_MAX_BUTTONS
        int "Maximum buttons per profile"
        range 1 64
        default 32

endmenu
```

## components/ir_types/Kconfig
```kconfig
menu "IR frame types"

    config IR_FRAME_MAX_EDGES
        int "Maximum level durations per captured IR frame"
        range 64 1024
        default 512
        help
            Upper bound on the number of mark/space durations stored for one
            captured frame. A typical NEC frame uses 68 edges; long air
            conditioner frames can exceed 300. Frames longer than this are
            rejected with an overflow event instead of being silently truncated.

endmenu
```

## components/led_indicator/Kconfig
```kconfig
menu "LED indicator"

    config LED_INDICATOR_PWM_FREQ_HZ
        int "LEDC PWM frequency (Hz)"
        range 100 40000
        default 5000
        help
            Low-speed LEDC PWM frequency driving the status LED.

    config LED_INDICATOR_PWM_RESOLUTION_BITS
        int "LEDC duty resolution (bits)"
        range 8 13
        default 10
        help
            PWM duty resolution. 10 bits gives 1024 brightness levels, which is
            plenty for indication patterns.

    config LED_INDICATOR_TICK_MS
        int "Pattern tick period (ms)"
        range 5 100
        default 10
        help
            Granularity of the pattern engine. Every pattern duration is rounded
            to a multiple of this value.

endmenu
```

## components/protocol/Kconfig
```kconfig
menu "Protocol (JSON-RPC over BLE)"

    config PROTOCOL_MAX_REQUEST
        int "Maximum request size (bytes)"
        range 256 4096
        default 2048
        help
            Inbound JSON larger than this is rejected. Keep it at or below
            BLE_LINK_RX_MAX, which bounds the transport itself.

    config PROTOCOL_MAX_RESPONSE
        int "Maximum response size (bytes)"
        range 512 8192
        default 4096
        help
            Responses larger than this are replaced by an E_TOO_LARGE error instead
            of being sent in pieces the peer did not ask for.

    config PROTOCOL_WAVEFORM_MAX_EDGES
        int "Maximum durations returned by button.waveform"
        range 32 1024
        default 256
        help
            Caps the size of a waveform response. Longer frames are truncated and
            the response sets "truncated": true.

    config PROTOCOL_LEARN_TIMEOUT_MS
        int "Default learn window (ms)"
        range 2000 120000
        default 20000
        help
            Used when button.learn does not specify timeoutMs.

endmenu
```

## main/Kconfig.projbuild
```kconfig
menu "Application"

    config APP_BRINGUP_STORE_TEST
        bool "Bring-up: run a storage round-trip test at boot"
        default n
        help
            Exercises NVS + SPIFFS: creates a profile, a button and a hotkey,
            exports everything into a RAM bundle, wipes the store, imports the
            bundle back and verifies the data including the raw frame bytes.
            WARNING: it begins with a factory reset and therefore erases any
            stored profiles.
            Off by default: it was used to verify ir_store and is now replaced by
            the protocol layer's own commands.

    config APP_BRINGUP_IR_TX_BLINK
        bool "Bring-up: blink the IR emitter pin before anything else"
        default n
        help
            Drives the emitter pin at 2.5 Hz with no carrier for about 20 seconds.
            Watch the IR LED through a phone camera: it must BLINK. A steady glow
            means you are looking at a power indicator LED, not the emitter, or
            that the emitter is not driven by the configured pin.
            Off by default: it was used to verify the emitter drive.

    config APP_BRINGUP_IR_LOOPBACK
        bool "Bring-up: run an IR transmit-to-receive loopback test at boot"
        default n
        help
            Emits a synthetic frame through the IR emitter and checks whether the
            receiver picks it up.
            Off by default: it was used to verify the IR TX+RX path.

    config APP_BRINGUP_IR_LEARN
        bool "Bring-up: auto-arm IR learning at boot"
        default n
        help
            Arms the IR receiver shortly after boot and logs what it sees, so the
            driver can be validated without the dashboard.
            Off by default: the protocol layer now arms learning on request.

    config APP_BRINGUP_IR_LEARN_WINDOW_MS
        int "Bring-up learn window (ms)"
        depends on APP_BRINGUP_IR_LEARN
        range 5000 600000
        default 180000
        help
            Generous by default so a bench session does not depend on pressing a
            remote within a few seconds of reset. Every captured frame restarts
            the window, and a reset reopens it.

endmenu
```
